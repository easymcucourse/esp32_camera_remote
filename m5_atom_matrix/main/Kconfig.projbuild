## m5_atom_matrix/main/Kconfig.projbuild
```kconfig
menu "Development console"
config REMOTE_DBG_SIM
    bool "UART debug: simulation commands"
    default y
    help
        RAM-only simulated input. Disable in production firmware.
config APP_DS4_DEBUG_LOG
    bool "Start DS4 host logs at DEBUG"
    default n
    help
        Also controllable for this boot with UART log ds4_host debug.
endmenu
```

## m5_atom_matrix/sdkconfig.defaults
```kconfig
CONFIG_IDF_TARGET="esp32"
CONFIG_COMPILER_OPTIMIZATION_PERF=y
CONFIG_ESP_DEFAULT_CPU_FREQ_MHZ_240=y
CONFIG_ESPTOOLPY_FLASHMODE_DIO=y
CONFIG_ESPTOOLPY_FLASHFREQ_40M=y
CONFIG_ESPTOOLPY_FLASHSIZE_4MB=y
CONFIG_ESP_CONSOLE_UART_DEFAULT=y
CONFIG_ESP_CONSOLE_UART_BAUDRATE=115200
CONFIG_FREERTOS_HZ=1000
CONFIG_I2C_ENABLE_SLAVE_DRIVER_VERSION_2=y
CONFIG_I2C_ISR_IRAM_SAFE=y
# Keep normal logs at INFO; enable DEBUG only for the ds4_host tag at runtime.
# CONFIG_LOG_MAXIMUM_EQUALS_DEFAULT is not set
CONFIG_LOG_MAXIMUM_LEVEL_DEBUG=y
CONFIG_BT_ENABLED=y
CONFIG_BT_BLUEDROID_ENABLED=y
CONFIG_BT_CLASSIC_ENABLED=y
# CONFIG_BT_SPP_ENABLED is not set
CONFIG_BT_HID_HOST_ENABLED=y
CONFIG_BT_HID_ENABLED=y
# CONFIG_BTDM_CTRL_MODE_BR_EDR_ONLY is not set
CONFIG_BTDM_CTRL_MODE_BTDM=y
CONFIG_BT_BLE_ENABLED=y
CONFIG_BT_GATTC_ENABLE=y
CONFIG_PARTITION_TABLE_SINGLE_APP_LARGE=y
```

## main/Kconfig.projbuild
```kconfig
menu "Camera station"
config APP_WIFI_COUNTRY
    string "Wi-Fi country code"
    default "JP"
    help
        Two-letter regulatory country code. JP allows channels 1-13.
        The runtime validates channels against the driver's country range.
endmenu
menu "Development console"
config REMOTE_DBG_SIM
    bool "Enable RAM-only local ATOM and gamepad simulation"
    default y
    help
        Disable for production. Local simulation bypasses physical I2C but uses
        the same protocol client and input safety handling. Clears on reboot.
config APP_DEBUG_FAULT_INJECTION
    bool "Enable RAM-only fault injection commands"
    default y
    help
        Disable for production. A persistent display fault intentionally tests
        controlled soft restart. Injected state clears on reboot.
endmenu
```
